## conf/layer.conf
```bitbake
# We have a conf and classes directory, append to BBPATH
BBPATH .= ":${LAYERDIR}"

# We have a recipes directory, add to BBFILES
BBFILES += "${LAYERDIR}/recipes*/*/*.bb ${LAYERDIR}/recipes*/*/*.bbappend"

BBFILE_COLLECTIONS += "meta-emlid-neutis-manufacturing"
BBFILE_PATTERN_meta-emlid-neutis-manufacturing := "^${LAYERDIR}/"
BBFILE_PRIORITY_meta-emlid-neutis-manufacturing = "10"
LAYERSERIES_COMPAT_meta-emlid-neutis-manufacturing = "rocko sumo"
```
